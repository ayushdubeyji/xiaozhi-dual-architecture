## firmware/esp32-s3-zero/sdkconfig.defaults
```kconfig
# ESP32-S3 Target Configuration
CONFIG_IDF_TARGET="esp32s3"

# ESP32-S3FH4R2 (Dual-Core LX7 @ 240MHz, 4MB Flash, 2MB Quad PSRAM)
CONFIG_ESP32S3_DEFAULT_CPU_FREQ_240=y
CONFIG_ESP32S3_DEFAULT_CPU_FREQ_MHZ=240

# Flash Memory: 4MB QIO @ 80MHz
CONFIG_ESPTOOLPY_FLASHMODE_QIO=y
CONFIG_ESPTOOLPY_FLASHFREQ_80M=y
CONFIG_ESPTOOLPY_FLASHSIZE_4MB=y

# Custom Partition Table (factory app 2.25MB + model 1MB)
CONFIG_PARTITION_TABLE_CUSTOM=y
CONFIG_PARTITION_TABLE_CUSTOM_FILENAME="partitions.csv"
CONFIG_PARTITION_TABLE_FILENAME="partitions.csv"

# Embedded Quad PSRAM (2MB QSPI)
CONFIG_SPIRAM=y
CONFIG_SPIRAM_MODE_QUAD=y
CONFIG_SPIRAM_TYPE_AUTO=y
CONFIG_SPIRAM_SPEED_80M=y
CONFIG_SPIRAM_BOOT_INIT=y
CONFIG_SPIRAM_USE_MALLOC=y
CONFIG_SPIRAM_MEMTEST=n
CONFIG_SPIRAM_TRY_ALLOCATE_WIFI_LWIP=y

# FreeRTOS Dual-Core & High-Resolution Tick
CONFIG_FREERTOS_UNICORE=n
CONFIG_FREERTOS_HZ=1000

# TinyUSB Composite Device (HID Keyboard + CDC ACM Stream + RNDIS/Net)
CONFIG_TINYUSB_RHPORT_FS=y
CONFIG_TINYUSB_HID_COUNT=1
CONFIG_TINYUSB_CDC_ENABLED=y
CONFIG_TINYUSB_CDC_COUNT=1
CONFIG_TINYUSB_NET_MODE_ECM_RNDIS=y
CONFIG_TINYUSB_DESC_USE_ESPRESSIF_VID=y
CONFIG_TINYUSB_DESC_USE_DEFAULT_PID=n
CONFIG_TINYUSB_DESC_CUSTOM_PID=0x4002
CONFIG_TINYUSB_DESC_BCD_DEVICE=0x0100
CONFIG_TINYUSB_DESC_MANUFACTURER_STRING="Waveshare"
CONFIG_TINYUSB_DESC_PRODUCT_STRING="ESP32-S3-Zero Xiaozhi Acoustic Node"
CONFIG_TINYUSB_DESC_SERIAL_STRING="S3ZERO-A7-PTT"
CONFIG_TINYUSB_TASK_STACK_SIZE=4096

# LwIP IP Forwarding & IPv4 NAPT (For on-demand RNDIS Wi-Fi NAT failover)
CONFIG_LWIP_IP_FORWARD=y
CONFIG_LWIP_IPV4_NAPT=y
CONFIG_LWIP_DHCPS=y
CONFIG_LWIP_MAX_SOCKETS=16
CONFIG_LWIP_SO_REUSE=y

# Wi-Fi & ESP-NOW
CONFIG_ESP_WIFI_STATIC_RX_BUFFER_NUM=10
CONFIG_ESP_WIFI_DYNAMIC_RX_BUFFER_NUM=32
CONFIG_ESP_WIFI_TX_BUFFER_TYPE=1
CONFIG_ESP_WIFI_DYNAMIC_TX_BUFFER_NUM=32
CONFIG_ESP_WIFI_AMPDU_TX_ENABLED=y
CONFIG_ESP_WIFI_TX_BA_WIN=6
CONFIG_ESP_WIFI_AMPDU_RX_ENABLED=y
CONFIG_ESP_WIFI_RX_BA_WIN=6

# ESP-SR WakeNet Model
CONFIG_SR_WN_WN9_HILEXIN=y

# WS2812 RMT Driver
CONFIG_RMT_ISR_IRAM_SAFE=y
```
